#include <string.h>
#include <stdio.h>
#include "freertos/FreeRTOS.h"
#include "freertos/task.h"
#include "driver/spi_master.h"
#include "driver/gpio.h"
#include "esp_log.h"
#include "esp_lcd_panel_io.h"
#include "esp_lcd_panel_ops.h"
#include "display.h"

static const char *TAG = "display";

/* SPI pin assignment (ESP32-C3 -> ILI9341) */
#define PIN_MOSI    6
#define PIN_SCK     4
#define PIN_CS      7
#define PIN_DC      5
#define PIN_RST     3
#define PIN_BL      8

#define LCD_HOST    SPI2_HOST
#define LCD_FREQ_HZ (40 * 1000 * 1000)

/* Tile row pixel buffer — one row at a time to stay within SRAM budget */
#define TILE_BUF_LINES  16
static uint16_t s_line_buf[TILE_BUF_LINES * DISPLAY_WIDTH];

static esp_lcd_panel_io_handle_t s_io_handle;
static esp_lcd_panel_handle_t    s_panel_handle;

/* ---- 8x16 bitmap font (ASCII 0x20–0x7E, 1 bit per pixel, column-major) ----
   Each character is 8 columns × 16 rows = 16 bytes (one byte per row).
   Source: public-domain 8x16 VGA font subset.                              */
static const uint8_t font8x16[][16] = {
    {0x00,0x00,0x00,0x00,0x00,0x00,0x00,0x00,0x00,0x00,0x00,0x00,0x00,0x00,0x00,0x00}, /* ' ' */
    {0x00,0x00,0x18,0x3C,0x3C,0x3C,0x18,0x18,0x18,0x00,0x18,0x18,0x00,0x00,0x00,0x00}, /* '!' */
    {0x00,0x63,0x63,0x63,0x22,0x00,0x00,0x00,0x00,0x00,0x00,0x00,0x00,0x00,0x00,0x00}, /* '"' */
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    {0x00,0x00,0x3B,0x6E,0x00,0x00,0x00,0x00,0x00,0x00,0x00,0x00,0x00,0x00,0x00,0x00}, /* '~' */
};

/* ILI9341 command bytes */
#define ILI9341_SWRESET   0x01
#define ILI9341_SLPOUT    0x11
#define ILI9341_DISPON    0x29
#define ILI9341_CASET     0x2A
#define ILI9341_PASET     0x2B
#define ILI9341_RAMWR     0x2C
#define ILI9341_MADCTL    0x36
#define ILI9341_COLMOD    0x3A
#define ILI9341_FRMCTR1   0xB1
#define ILI9341_DFUNCTR   0xB6
#define ILI9341_PWCTR1    0xC0
#define ILI9341_PWCTR2    0xC1
#define ILI9341_VMCTR1    0xC5
#define ILI9341_VMCTR2    0xC7
#define ILI9341_GMCTRP1   0xE0
#define ILI9341_GMCTRN1   0xE1

static void ili9341_send_cmd(uint8_t cmd)
{
    esp_lcd_panel_io_tx_param(s_io_handle, cmd, NULL, 0);
}

static void ili9341_send_data(const uint8_t *data, size_t len)
{
    esp_lcd_panel_io_tx_color(s_io_handle, -1, data, len);
}

static void ili9341_init_sequence(void)
{
    const uint8_t d1[]  = {0x00, 0x83, 0x30};
    const uint8_t d2[]  = {0x85, 0x01, 0x79};
    const uint8_t d3[]  = {0x39, 0x2C, 0x00, 0x34, 0x02};
    const uint8_t d4[]  = {0x20};
    const uint8_t d5[]  = {0x00, 0xD9};
    const uint8_t d6[]  = {0x48};
    const uint8_t d7[]  = {0x55};  /* RGB565 */
    const uint8_t d8[]  = {0x00, 0x18};
    const uint8_t d9[]  = {0x09, 0x82};
    const uint8_t d10[] = {0x45, 0x15};
    const uint8_t d11[] = {0x90};
    const uint8_t madctl[] = {0x88}; /* MY=1, BGR=1, portrait 180° (MX=0,MY=1) */

    ili9341_send_cmd(ILI9341_SWRESET);
    vTaskDelay(pdMS_TO_TICKS(120));
    ili9341_send_cmd(ILI9341_SLPOUT);
    vTaskDelay(pdMS_TO_TICKS(120));

    /* Extended command sequence */
    esp_lcd_panel_io_tx_param(s_io_handle, 0xCF, d1, sizeof(d1));
    esp_lcd_panel_io_tx_param(s_io_handle, 0xED, d2, sizeof(d2));
    esp_lcd_panel_io_tx_param(s_io_handle, 0xE8, d3, sizeof(d3));
    esp_lcd_panel_io_tx_param(s_io_handle, 0xCB, (uint8_t[]){0x39,0x2C,0x00,0x34,0x02}, 5);
    esp_lcd_panel_io_tx_param(s_io_handle, 0xF7, d4, sizeof(d4));
    esp_lcd_panel_io_tx_param(s_io_handle, 0xEA, d5, sizeof(d5));
    esp_lcd_panel_io_tx_param(s_io_handle, ILI9341_PWCTR1, d6, sizeof(d6));
    esp_lcd_panel_io_tx_param(s_io_handle, ILI9341_PWCTR2, (uint8_t[]){0x10}, 1);
    esp_lcd_panel_io_tx_param(s_io_handle, ILI9341_VMCTR1, d10, sizeof(d10));
    esp_lcd_panel_io_tx_param(s_io_handle, ILI9341_VMCTR2, d11, sizeof(d11));
    esp_lcd_panel_io_tx_param(s_io_handle, ILI9341_MADCTL, madctl, sizeof(madctl));
    esp_lcd_panel_io_tx_param(s_io_handle, ILI9341_COLMOD, d7, sizeof(d7));
    esp_lcd_panel_io_tx_param(s_io_handle, ILI9341_FRMCTR1, d8, sizeof(d8));
    esp_lcd_panel_io_tx_param(s_io_handle, ILI9341_DFUNCTR, d9, sizeof(d9));
    esp_lcd_panel_io_tx_param(s_io_handle, 0xF2, (uint8_t[]){0x00}, 1);
    esp_lcd_panel_io_tx_param(s_io_handle, 0x26, (uint8_t[]){0x01}, 1);

    static const uint8_t gmctp[] = {0x0F,0x31,0x2B,0x0C,0x0E,0x08,0x4E,0xF1,0x37,0x07,0x10,0x03,0x0E,0x09,0x00};
    static const uint8_t gmctn[] = {0x00,0x0E,0x14,0x03,0x11,0x07,0x31,0xC1,0x48,0x08,0x0F,0x0C,0x31,0x36,0x0F};
    esp_lcd_panel_io_tx_param(s_io_handle, ILI9341_GMCTRP1, gmctp, sizeof(gmctp));
    esp_lcd_panel_io_tx_param(s_io_handle, ILI9341_GMCTRN1, gmctn, sizeof(gmctn));

    ili9341_send_cmd(ILI9341_DISPON);
    vTaskDelay(pdMS_TO_TICKS(10));
}

/* ---- public API ---- */

esp_err_t display_init(void)
{
    /* Backlight off during init */
    gpio_config_t bl_cfg = {
        .pin_bit_mask = (1ULL << PIN_BL),
        .mode = GPIO_MODE_OUTPUT,
    };
    gpio_config(&bl_cfg);
    gpio_set_level(PIN_BL, 0);

    /* SPI bus */
    spi_bus_config_t bus_cfg = {
        .mosi_io_num = PIN_MOSI,
        .miso_io_num = -1,
        .sclk_io_num = PIN_SCK,
        .quadwp_io_num = -1,
        .quadhd_io_num = -1,
        .max_transfer_sz = TILE_BUF_LINES * DISPLAY_WIDTH * 2,
    };
    ESP_ERROR_CHECK(spi_bus_initialize(LCD_HOST, &bus_cfg, SPI_DMA_CH_AUTO));

    /* Panel IO */
    esp_lcd_panel_io_spi_config_t io_cfg = {
        .dc_gpio_num = PIN_DC,
        .cs_gpio_num = PIN_CS,
        .pclk_hz = LCD_FREQ_HZ,
        .lcd_cmd_bits = 8,
        .lcd_param_bits = 8,
        .spi_mode = 0,
        .trans_queue_depth = 10,
    };
    ESP_ERROR_CHECK(esp_lcd_new_panel_io_spi((esp_lcd_spi_bus_handle_t)LCD_HOST, &io_cfg, &s_io_handle));

    /* Hardware reset */
    gpio_config_t rst_cfg = {
        .pin_bit_mask = (1ULL << PIN_RST),
        .mode = GPIO_MODE_OUTPUT,
    };
    gpio_config(&rst_cfg);
    gpio_set_level(PIN_RST, 0);
    vTaskDelay(pdMS_TO_TICKS(10));
    gpio_set_level(PIN_RST, 1);
    vTaskDelay(pdMS_TO_TICKS(10));

    ili9341_init_sequence();

    gpio_set_level(PIN_BL, 1);
    ESP_LOGI(TAG, "display initialised (%dx%d)", DISPLAY_WIDTH, DISPLAY_HEIGHT);
    return ESP_OK;
}

void display_fill_rect(int x, int y, int w, int h, uint16_t color)
{
    /* Swap bytes for SPI (big-endian) */
    uint16_t c = (color >> 8) | (color << 8);
    int lines_at_a_time = TILE_BUF_LINES;
    int y_end = y + h;

    for (int row = y; row < y_end; row += lines_at_a_time) {
        int chunk = (row + lines_at_a_time <= y_end) ? lines_at_a_time : (y_end - row);
        int pixels = w * chunk;
        for (int i = 0; i < pixels; i++) s_line_buf[i] = c;
        esp_lcd_panel_io_tx_color(s_io_handle, -1, NULL, 0); /* dummy to flush */
        /* Use raw CASET/PASET/RAMWR */
        uint8_t caset[4] = {x >> 8, x & 0xFF, (x+w-1) >> 8, (x+w-1) & 0xFF};
        uint8_t paset[4] = {row >> 8, row & 0xFF, (row+chunk-1) >> 8, (row+chunk-1) & 0xFF};
        esp_lcd_panel_io_tx_param(s_io_handle, ILI9341_CASET, caset, 4);
        esp_lcd_panel_io_tx_param(s_io_handle, ILI9341_PASET, paset, 4);
        esp_lcd_panel_io_tx_color(s_io_handle, ILI9341_RAMWR, s_line_buf, pixels * 2);
    }
}

void display_fill_color(uint16_t color)
{
    display_fill_rect(0, 0, DISPLAY_WIDTH, DISPLAY_HEIGHT, color);
}

static void draw_char(int x, int y, char c, uint16_t fg, uint16_t bg)
{
    if (c < 0x20 || c > 0x7E) c = '?';
    const uint8_t *glyph = font8x16[c - 0x20];
    uint16_t fg_be = (fg >> 8) | (fg << 8);
    uint16_t bg_be = (bg >> 8) | (bg << 8);

    for (int row = 0; row < 16; row++) {
        uint8_t bits = glyph[row];
        for (int col = 0; col < 8; col++) {
            s_line_buf[col] = (bits & (0x80 >> col)) ? fg_be : bg_be;
        }
        uint8_t caset[4] = {x >> 8, x & 0xFF, (x+7) >> 8, (x+7) & 0xFF};
        uint8_t paset[4] = {(y+row) >> 8, (y+row) & 0xFF, (y+row) >> 8, (y+row) & 0xFF};
        esp_lcd_panel_io_tx_param(s_io_handle, ILI9341_CASET, caset, 4);
        esp_lcd_panel_io_tx_param(s_io_handle, ILI9341_PASET, paset, 4);
        esp_lcd_panel_io_tx_color(s_io_handle, ILI9341_RAMWR, s_line_buf, 16);
    }
}

void display_draw_text(int x, int y, const char *text, uint16_t fg, uint16_t bg)
{
    while (*text) {
        if (x + 8 > DISPLAY_WIDTH) break;
        draw_char(x, y, *text++, fg, bg);
        x += 8;
    }
}

/* 2× scale text for larger readability */
void display_draw_text_large(int x, int y, const char *text, uint16_t fg, uint16_t bg)
{
    uint16_t fg_be = (fg >> 8) | (fg << 8);
    uint16_t bg_be = (bg >> 8) | (bg << 8);

    while (*text) {
        char c = *text++;
        if (c < 0x20 || c > 0x7E) c = '?';
        const uint8_t *glyph = font8x16[c - 0x20];

        for (int row = 0; row < 16; row++) {
            uint8_t bits = glyph[row];
            /* Two scaled rows per source row */
            for (int sr = 0; sr < 2; sr++) {
                for (int col = 0; col < 8; col++) {
                    uint16_t px = (bits & (0x80 >> col)) ? fg_be : bg_be;
                    s_line_buf[col*2]   = px;
                    s_line_buf[col*2+1] = px;
                }
                int py = y + row * 2 + sr;
                uint8_t caset[4] = {x >> 8, x & 0xFF, (x+15) >> 8, (x+15) & 0xFF};
                uint8_t paset[4] = {py >> 8, py & 0xFF, py >> 8, py & 0xFF};
                esp_lcd_panel_io_tx_param(s_io_handle, ILI9341_CASET, caset, 4);
                esp_lcd_panel_io_tx_param(s_io_handle, ILI9341_PASET, paset, 4);
                esp_lcd_panel_io_tx_color(s_io_handle, ILI9341_RAMWR, s_line_buf, 32);
            }
        }
        x += 16;
        if (x + 16 > DISPLAY_WIDTH) break;
    }
}

/* ---- Phase 2 helpers ---- */

void display_draw_hline(int y, uint16_t color)
{
    display_fill_rect(0, y, DISPLAY_WIDTH, 2, color);
}

void display_draw_text_centered(int y, const char *text, uint16_t fg, uint16_t bg)
{
    int len = (int)strlen(text);
    int x   = (DISPLAY_WIDTH - len * 8) / 2;
    if (x < 0) x = 0;
    display_draw_text(x, y, text, fg, bg);
}

/* ---- Boot-phase scrolling log overlay ----------------------------------------
 * Header row occupies y=0..BOOT_LOG_HEADER_H-1 (drawn by draw_splash).
 * Log lines fill y=BOOT_LOG_HEADER_H downward; new lines scroll old ones up.
 * display_log_add() is safe to call from any task or the vprintf hook.        */

#define BOOT_LOG_MAX_LINES  18
#define BOOT_LOG_LINE_CHARS 30
#define BOOT_LOG_HEADER_H   18
#define BOOT_LOG_LINE_H     16

static char         s_log_buf[BOOT_LOG_MAX_LINES][BOOT_LOG_LINE_CHARS + 1];
static int          s_log_count;
static portMUX_TYPE s_log_mux = portMUX_INITIALIZER_UNLOCKED;

void display_log_add(const char *msg)
{
    taskENTER_CRITICAL(&s_log_mux);
    if (s_log_count < BOOT_LOG_MAX_LINES) {
        strlcpy(s_log_buf[s_log_count++], msg, BOOT_LOG_LINE_CHARS + 1);
    } else {
        memmove(s_log_buf[0], s_log_buf[1],
                (size_t)(BOOT_LOG_MAX_LINES - 1) * (BOOT_LOG_LINE_CHARS + 1));
        strlcpy(s_log_buf[BOOT_LOG_MAX_LINES - 1], msg, BOOT_LOG_LINE_CHARS + 1);
    }
    taskEXIT_CRITICAL(&s_log_mux);
}

void display_log_render(void)
{
    char snap[BOOT_LOG_MAX_LINES][BOOT_LOG_LINE_CHARS + 1];
    int  count;
    taskENTER_CRITICAL(&s_log_mux);
    count = s_log_count;
    memcpy(snap, s_log_buf, sizeof(snap));
    taskEXIT_CRITICAL(&s_log_mux);

    for (int i = 0; i < BOOT_LOG_MAX_LINES; i++) {
        int y = BOOT_LOG_HEADER_H + i * BOOT_LOG_LINE_H;
        if (i < count) {
            /* Pad to full line width so leftover chars from prior entries are erased */
            char line[BOOT_LOG_LINE_CHARS + 1];
            snprintf(line, sizeof(line), "%-30s", snap[i]);
            display_draw_text(0, y, line, RGB565(0, 180, 0), COLOR_BLACK);
        } else {
            display_fill_rect(0, y, DISPLAY_WIDTH, BOOT_LOG_LINE_H, COLOR_BLACK);
        }
    }
}
